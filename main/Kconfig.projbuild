## main/Kconfig.projbuild
```kconfig
menu "P4-NANO Games"
    choice P4GAME_BOOT_MODE
        prompt "Startup mode"
        default P4GAME_BOARD_CHECK
        config P4GAME_BOARD_CHECK
            bool "Board and emulator diagnostics (no external peripherals required)"
        config P4GAME_PERIPHERAL_TEST
            bool "Display, buttons, audio and SD diagnostics"
        config P4GAME_ROM_TEST
            bool "Private embedded ROM test over SPI/I2S (no SD required)"
        config P4GAME_PLAY
            bool "Play ROM from microSD"
    endchoice
    config P4GAME_TEST_FRAMES
        int "Frames in private ROM diagnostic"
        depends on P4GAME_ROM_TEST
        range 600 36000
        default 7200
    config P4GAME_LCD_CLOCK_HZ
        int "Display SPI clock (Hz)"
        range 1000000 80000000
        default 20000000
        help
            20 MHz is the baseline of the supplied ST7789 profile.
            Higher clocks require validation on the actual module.
    config P4GAME_AUDIO_VOLUME
        int "Speaker volume (%)"
        range 0 100
        default 95
    config P4GAME_ROM_PATH
        string "ROM path"
        default "/sd/roms/comix_zone.bin"
endmenu
```

## sdkconfig.defaults
```kconfig
CONFIG_IDF_TARGET="esp32p4"
CONFIG_ESP32P4_SELECTS_REV_LESS_V3=y
CONFIG_ESP32P4_REV_MIN_100=y
CONFIG_ESPTOOLPY_FLASHSIZE_16MB=y
CONFIG_ESPTOOLPY_FLASHMODE_DIO=y
CONFIG_ESPTOOLPY_FLASHFREQ_80M=y
CONFIG_PARTITION_TABLE_CUSTOM=y
CONFIG_PARTITION_TABLE_CUSTOM_FILENAME="partitions.csv"
CONFIG_ESP_DEFAULT_CPU_FREQ_MHZ_360=y
CONFIG_COMPILER_OPTIMIZATION_PERF=y
CONFIG_SPIRAM=y
CONFIG_SPIRAM_SPEED_200M=y
CONFIG_SPIRAM_MEMTEST=y
CONFIG_SPIRAM_MALLOC_RESERVE_INTERNAL=65536
CONFIG_FREERTOS_HZ=1000
CONFIG_ESP_MAIN_TASK_STACK_SIZE=8192
CONFIG_ESP_CONSOLE_UART_DEFAULT=y
CONFIG_ESP_CONSOLE_UART_BAUDRATE=115200
CONFIG_ESP_CONSOLE_SECONDARY_NONE=y
CONFIG_LOG_DEFAULT_LEVEL_INFO=y
CONFIG_CODEC_ES7210_SUPPORT=n
CONFIG_CODEC_ES7243_SUPPORT=n
CONFIG_CODEC_ES7243E_SUPPORT=n
CONFIG_CODEC_ES8156_SUPPORT=n
CONFIG_CODEC_AW88298_SUPPORT=n
CONFIG_CODEC_ES8389_SUPPORT=n
CONFIG_CODEC_ES8374_SUPPORT=n
CONFIG_CODEC_ES8388_SUPPORT=n
CONFIG_CODEC_TAS5805M_SUPPORT=n
CONFIG_SPIRAM_XIP_FROM_PSRAM=y
CONFIG_CACHE_L2_CACHE_256KB=y
CONFIG_FATFS_LFN_HEAP=y
```
